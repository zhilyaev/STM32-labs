#include "stm32f3xx.h"

#define MAN_PLLMUL_VALUE 0x000C0000 // 5
#define MAN_PLL_ON 0x01000000
#define MAN_PLLRDY_ON 0x02000000
#define MAN_RCC_GLIOE_ON 0x00200000
#define MAN_GPIOE_MODER_RESET 0xFFFFFCFF
#define MAN_GPIOE_MODER_OUT 0x55555555

#define MAN_LED_BLUE1 0x00000100
#define MAN_LED_BLUE2 0x00001000
#define MAN_LED_RED1 0x00000200
#define MAN_LED_RED2 0x00002000
#define MAN_LED_GREEN1 0x00000800
#define MAN_LED_GREEN2 0x00008000
#define MAN_LED_ORANGE1 0x00000400
#define MAN_LED_ORANGE2 0x00004000

const uint32_t RESET_VALUE = 200000;
uint32_t LED_ON_VALUE;
uint32_t counter;
char colorNumber;
uint32_t ledOrder[15] = { 
	MAN_LED_RED1, 
	MAN_LED_RED1 | MAN_LED_ORANGE1,
	MAN_LED_RED1 | MAN_LED_ORANGE1 | MAN_LED_GREEN1,
	MAN_LED_RED1 | MAN_LED_ORANGE1 | MAN_LED_GREEN1 | MAN_LED_BLUE2, 
	MAN_LED_RED1 | MAN_LED_ORANGE1 | MAN_LED_GREEN1 | MAN_LED_BLUE2 | MAN_LED_RED2, 
	MAN_LED_RED1 | MAN_LED_ORANGE1 | MAN_LED_GREEN1 | MAN_LED_BLUE2 | MAN_LED_RED2 | MAN_LED_ORANGE2,
	MAN_LED_RED1 | MAN_LED_ORANGE1 | MAN_LED_GREEN1 | MAN_LED_BLUE2 | MAN_LED_RED2 | MAN_LED_ORANGE2 | MAN_LED_GREEN2, 
	MAN_LED_RED1 | MAN_LED_ORANGE1 | MAN_LED_GREEN1 | MAN_LED_BLUE2 | MAN_LED_RED2 | MAN_LED_ORANGE2 | MAN_LED_GREEN2 | MAN_LED_BLUE1,
	MAN_LED_RED1 | MAN_LED_ORANGE1 | MAN_LED_GREEN1 | MAN_LED_BLUE2 | MAN_LED_RED2 | MAN_LED_ORANGE2 | MAN_LED_GREEN2, 
	MAN_LED_RED1 | MAN_LED_ORANGE1 | MAN_LED_GREEN1 | MAN_LED_BLUE2 | MAN_LED_RED2 | MAN_LED_ORANGE2,
	MAN_LED_RED1 | MAN_LED_ORANGE1 | MAN_LED_GREEN1 | MAN_LED_BLUE2 | MAN_LED_RED2 ,
	MAN_LED_RED1 | MAN_LED_ORANGE1 | MAN_LED_GREEN1 | MAN_LED_BLUE2 ,
	MAN_LED_RED1 | MAN_LED_ORANGE1 | MAN_LED_GREEN1 ,
	MAN_LED_RED1 | MAN_LED_ORANGE1 ,
	MAN_LED_RED1 ,
};

uint32_t myRoundList[8] = {
MAN_LED_RED1, MAN_LED_ORANGE1, MAN_LED_GREEN1, MAN_LED_BLUE1, MAN_LED_RED2, MAN_LED_ORANGE2, MAN_LED_GREEN2, MAN_LED_BLUE2
};
			
void setPLLMUL(const uint32_t value){
	/* value: RCC_CFGR = RCC_CFGR | value */
	if (RCC->CR & MAN_PLL_ON){  // if PLL is on turn off PLL
		RCC->CR &= !MAN_PLL_ON;
	}
	if (!(RCC->CR & MAN_PLL_ON)){ // if PLL is off
		while (RCC->CR & MAN_PLLRDY_ON);
		if (!(RCC->CR & MAN_PLLRDY_ON)){ // if PLLRDY == 0
			RCC->CFGR &= 0xFFC3FFFF;
			RCC->CFGR |= value;  // set PLLMUL
			RCC->CR |= MAN_PLL_ON;  // turn on PLL
		}
	}
}

void ledInit(){
	RCC->AHBENR |= MAN_RCC_GLIOE_ON;  // connect port E to RCC
	GPIOE->MODER &= MAN_GPIOE_MODER_RESET;
	GPIOE->MODER |= MAN_GPIOE_MODER_OUT;
}

void ledOn(const uint32_t ledSet) {
	GPIOE->ODR &= 0;
	GPIOE->ODR |= ledSet;
}
void ledOff() {
	GPIOE->ODR &= 0;
}

int main(void) {
	setPLLMUL(MAN_PLLMUL_VALUE);
	ledInit();
	LED_ON_VALUE = 50000;
	colorNumber = 0;
	while(1) {
		colorNumber = (colorNumber < sizeof(ledOrder)/sizeof(uint32_t)) ? colorNumber : 0;
		counter = RESET_VALUE;
		ledOff();
		while(counter--) {
			if (counter == LED_ON_VALUE)
				ledOn(ledOrder[colorNumber++]);
		}
	}
}